## config/west.yml
```yaml
manifest:
  remotes:
    - name: zmkfirmware
      url-base: https://github.com/zmkfirmware
    - name: ergonautkb
      url-base: https://github.com/ergonautkb
    - name: my-prospector
      url-base: https://github.com/mpich
  projects:
    - name: zmk
      remote: zmkfirmware
      revision: main
      import: app/west.yml
      
    - name: ergonautkb-zmk-module
      remote: ergonautkb
      revision: main
      
    - name: prospector-zmk-module
      remote: my-prospector
      revision: fix-peripheral-modifier-listener
      path: modules/prospector-zmk-module
  self:
    path: config
```
